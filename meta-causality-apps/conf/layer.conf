## meta-causality-apps/conf/layer.conf
```bitbake
# Application layer: hardware-independent recipes only.
# Board-specific settings belong in meta-causality-bsp.

BBPATH .= ":${LAYERDIR}"

BBFILES += "${LAYERDIR}/recipes-*/*/*.bb \
            ${LAYERDIR}/recipes-*/*/*.bbappend"

BBFILE_COLLECTIONS += "meta-causality-apps"
BBFILE_PATTERN_meta-causality-apps = "^${LAYERDIR}/"
BBFILE_PRIORITY_meta-causality-apps = "10"

LAYERDEPENDS_meta-causality-apps = "core"
LAYERSERIES_COMPAT_meta-causality-apps = "scarthgap"
```

## meta-causality-bsp/conf/layer.conf
```bitbake
# BSP layer: kernel config, device names and per-board settings.

BBPATH .= ":${LAYERDIR}"

BBFILES += "${LAYERDIR}/recipes-*/*/*.bb \
            ${LAYERDIR}/recipes-*/*/*.bbappend"

BBFILE_COLLECTIONS += "meta-causality-bsp"
BBFILE_PATTERN_meta-causality-bsp = "^${LAYERDIR}/"
BBFILE_PRIORITY_meta-causality-bsp = "11"

LAYERDEPENDS_meta-causality-bsp = "core freescale-layer"
LAYERSERIES_COMPAT_meta-causality-bsp = "scarthgap"
```
