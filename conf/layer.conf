## conf/layer.conf
```bitbake
# We have a conf and classes directory, add to BBPATH
BBPATH .= ":${LAYERDIR}"

# We have recipes-* directories, add to BBFILES
BBFILES += "${LAYERDIR}/recipes-*/*/*.bb \
            ${LAYERDIR}/recipes-*/*/*.bbappend"

BBFILE_COLLECTIONS += "meta-causality-labs"
BBFILE_PATTERN_meta-causality-labs = "^${LAYERDIR}/"
BBFILE_PRIORITY_meta-causality-labs = "10"

LAYERDEPENDS_meta-causality-labs = "core"
LAYERSERIES_COMPAT_meta-causality-labs = "scarthgap"
```
